/dts-v1/;
/plugin/;

#include <dt-bindings/input/input.h>
#include <dt-bindings/gpio/gpio.h>

/ {
    compatible = "brcm,bcm2712";
    fragment@0 {
        target-path = "/";
        __overlay__ {
            my_devices {
                compatible = "custom,mydriver";

                led-gpios = <&gpio 23 GPIO_ACTIVE_HIGH>, /* yellow */
                            <&gpio 24 GPIO_ACTIVE_HIGH>, /* green */
                            <&gpio 25 GPIO_ACTIVE_HIGH>; /* red */

                button-gpios = <&gpio 27 (GPIO_ACTIVE_LOW | 16)>, /* right */
                               <&gpio 17 (GPIO_ACTIVE_LOW | 16)>; /* left */

                status = "okay";
            };
        };
    };
};
